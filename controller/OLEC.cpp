//##########################################################################
//
// lcall3 Controller is free software: you can redistribute it and/or modify
// it under the terms of the GNU General Public License as published by
// the Free Software Foundation, either version 3 of the License, or
// (at your option) any later version.
//
// lcall3 Controller is distributed in the hope that it will be useful,
// but WITHOUT ANY WARRANTY; without even the implied warranty of
// MERCHANTABILITY or FITNESS FOR A PARTICULAR PURPOSE.  See the
// GNU General Public License for more details.
//
// You should have received a copy of the GNU General Public License
// along with lcall3 Controller. If not, see <http://www.gnu.org/licenses/>.
//
//##########################################################################

#include "Arduino.h"
#include "Wire.h"
#include "OLED.h"

#include <avr/pgmspace.h>

// Program memory
#if defined(__arm__) && !defined(PROGMEM)
    #define PROGMEM
    #define pgm_read_byte(STR) STR
#endif

// 8x8 ASCII fonts (127 characters)
const unsigned char BasicFont[][8] PROGMEM= {
    {0x00,0x00,0x00,0x00,0x00,0x00,0x00,0x00},
    {0x00,0x00,0x5F,0x00,0x00,0x00,0x00,0x00},
    {0x00,0x00,0x07,0x00,0x07,0x00,0x00,0x00},
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    {0x00,0x02,0x05,0x05,0x02,0x00,0x00,0x00} 
};

void OLED::init() {
    sendCommand(0xFD);      // Unlock OLED driver IC MCU interface from entering command. i.e: Accept commands
    sendCommand(0x12);
    sendCommand(0xAE);      // Set display off
    sendCommand(0xA8);      // set multiplex ratio
    sendCommand(0x5F);      // 96
    sendCommand(0xA1);      // set display start line
    sendCommand(0x00);
    sendCommand(0xA2);      // set display offset
    sendCommand(0x60);
    sendCommand(0xA0);      // set remap
    sendCommand(0x46);
    sendCommand(0xAB);      // set vdd internal
    sendCommand(0x01);      //
    sendCommand(0x81);      // set contrasr
    sendCommand(0x53);      // 100 nit
    sendCommand(0xB1);      // Set Phase Length
    sendCommand(0X51);      //
    sendCommand(0xB3);      // Set Display Clock Divide Ratio/Oscillator Frequency
    sendCommand(0x01);
    sendCommand(0xB9);      //
    sendCommand(0xBC);      // set pre_charge voltage/VCOMH
    sendCommand(0x08);      // (0x08);
    sendCommand(0xBE);      // set VCOMH
    sendCommand(0X07);      // (0x07);
    sendCommand(0xB6);      // Set second pre-charge period
    sendCommand(0x01);      //
    sendCommand(0xD5);      // enable second precharge and enternal vsl
    sendCommand(0X62);      // (0x62);
    sendCommand(0xA4);      // Set Normal Display Mode
    sendCommand(0x2E);      // Deactivate Scroll
    sendCommand(0xAF);      // Switch on display
    delay(100);

    // Row Address
    sendCommand(0x75);      // Set Row Address 
    sendCommand(0x00);      // Start 0
    sendCommand(0x5f);      // End 95 


    // Column Address
    sendCommand(0x15);      // Set Column Address 
    sendCommand(0x08);      // Start from 8th Column of driver IC. This is 0th Column for OLED 
    sendCommand(0x37);      // End at  (8 + 47)th column. Each Column has 2 pixels(segments)

    // Init gray level for text. Default:Brightest White
    grayH= 0xF0;
    grayL= 0x0F;
}

void OLED::sendCommand(unsigned char cmd) {
    Wire.beginTransmission(OLED_Address);
    Wire.write(OLED_Command_Mode);
    Wire.write(command);
    Wire.endTransmission();
}

void OLED::setContrastLevel(unsigned char level) {
    sendCommand(OLED_Set_ContrastLevel_Cmd);
    sendCommand(level);
}

void OLED::setHorizontalMode() {
    sendCommand(0xA0); // remap to
    sendCommand(0x42); // horizontal mode

    // Row Address
    sendCommand(0x75);    // Set Row Address 
    sendCommand(0x00);    // Start 0
    sendCommand(0x5f);    // End 95 

    // Column Address
    sendCommand(0x15);    // Set Column Address 
    sendCommand(0x08);    // Start from 8th Column of driver IC. This is 0th Column for OLED 
    sendCommand(0x37);    // End at  (8 + 47)th column. Each Column has 2 pixels(or segments)
}

// Sets the starting cursor for text printing
void OLED::setTextXY(unsigned char row, unsigned char col) {
    sendCommand(0x15);             /* Set Column Address */
    sendCommand(0x08+(col*4));  /* Start Column: Start from 8 */
    sendCommand(0x37);             /* End Column */

    // Row Address
    sendCommand(0x75);             /* Set Row Address */
    sendCommand(0x00+(row*8));     /* Start Row*/
    sendCommand(0x07+(row*8));     /* End Row*/
}

void OLED::clearDisplay() {
    unsigned char i, j;
    for(j=0; j<48; j++) {
        for(i=0; i<96; i++) {
            sendData(0x00);
        }
    }
}

void OLED::sendData(unsigned char data) {
    Wire.beginTransmission(OLED_Address); // begin I2C transmission
    Wire.write(OLED_Data_Mode);            // data mode
    Wire.write(data);
    Wire.endTransmission();                    // stop I2C transmission
}

void OLED::setGrayLevel(unsigned char level) {
    grayH = (level << 4) & 0xF0;
    grayL =  level & 0x0F;
}

void OLED::putChar(unsigned char c) {
    if (c < 32 || c > 127) {
        c = ' ';
    }

    for (char i=0; i < 8; i+= 2) {
        for (char j=0; j < 8; j++) {
            char cout=0x00;
            char bit1=(pgm_read_byte(&BasicFont[C-32][i]) >> j)  & 0x01;
            char bit2=(pgm_read_byte(&BasicFont[C-32][i+1]) >> j) & 0x01;
            cout |=(bit1)?grayH:0x00;
            cout |=(bit2)?grayL:0x00;

            sendData(cout);
        }
    }
}

void OLED::putString(const char *msg) {
    unsigned char i = 0;
    while (msg[i]) {
        putChar(msg[i]);
        i++;
    }
}

unsigned char OLED::putNumber(long n) {
    unsigned char char_buffer[10]="";
    unsigned char i = 0;
    unsigned char f = 0;

    if (n < 0) {
        f = 1;
        putChar('-');
        n = -n;
    } else if (n == 0) {
        f = 1;
        putChar('0');
        return f;
    }

    while (n > 0) {
        char_buffer[i++] = n % 10;
        n /= 10;
    }

    f = f + i;
    for(; i > 0; i--) {
        putChar('0'+ char_buffer[i - 1]);
    }

    return f;
}

void OLED::drawBitmap(const unsigned char *bitmaparray, int bytes) {
    char localAddressMode = addressingMode;
    if (addressingMode != HORIZONTAL_MODE) {
        //Bitmap is drawn in horizontal mode
        setHorizontalMode();
    }

    for (int i=0; i<bytes; i++) {
        for (int j=0; j<8; j=j+2) {
            char c=0x00;
            char bit1=pgm_read_byte(&bitmaparray[i]) << j & 0x80;
            char bit2=pgm_read_byte(&bitmaparray[i]) << (j+1) & 0x80;

            // Each bit is changed to a nibble
            c|=(bit1)?grayH:0x00;
            // Each bit is changed to a nibble
            c|=(bit2)?grayL:0x00;
            sendData(c);
        }
    }
    if (localAddressMode == VERTICAL_MODE) {
        //If Vertical Mode was used earlier, restore it.
        setVerticalMode();
    }
}

/*
 *  Use the following defines for 'direction' :
 *      Scroll_Left
 *      Scroll_Right
 *  Use the following defines for 'scrollSpeed' :
 *      Scroll_2Frames
 *      Scroll_3Frames
 *      Scroll_4Frames
 *      Scroll_5Frames 
 *      Scroll_25Frames
 *      Scroll_64Frames
 *      Scroll_128Frames
 *      Scroll_256Frames
 */
void OLED::setHorizontalScrollProperties(
    bool direction,
    unsigned char startRow,
    unsigned char endRow,
    unsigned char startColumn,
    unsigned char endColumn,
    unsigned char scrollSpeed
) {
    if(Scroll_Right == direction) {
        //Scroll Right
        sendCommand(0x27);
    } else {
        //Scroll Left
        sendCommand(0x26);
    }

    sendCommand(0x00);       //Dummmy byte
    sendCommand(startRow);
    sendCommand(scrollSpeed);
    sendCommand(endRow);
    sendCommand(startColumn+8);
    sendCommand(endColumn+8);
    sendCommand(0x00);      //Dummmy byte
}

void OLED::activateScroll() {
    sendCommand(OLED_Activate_Scroll_Cmd);
}

void OLED::deactiveScroll() {
    sendCommand(OLED_Deactivate_Scroll_Cmd);
}

void OLED::setNormalDisplay() {
    sendCommand(OLED_Normal_Display_Cmd);
}

void OLED::setInverseDisplay() {
    sendCommand(OLED_Inverse_Display_Cmd);
}

// Preinstantiate Object
OLED oled;